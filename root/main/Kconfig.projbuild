## root/main/Kconfig.projbuild
```kconfig
menu "Example Configuration"

config ROUTER_SSID
    string "Router SSID"
        default "ROUTER_SSID"
        help
            Router SSID.

config ROUTER_PASSWORD
    string "Router password"
        default "ROUTER_PASSWORD"
        help
            Router password.

choice DEVICE_TYPE
    bool "Configure the device type"
    default DEVICE_TYPE_NODE
    help
        Configure the device type

config DEVICE_TYPE_ROOT
   bool "Root device"
config DEVICE_TYPE_NODE
   bool "Non-Root device"
endchoice

config DEVICE_TYPE
    int
    default 1 if DEVICE_TYPE_ROOT
    default 2 if DEVICE_TYPE_NODE

config MESH_ID
    string "Mesh ID"
        default "123456"
        help
            The maximum length is 6 bytes. Mesh network identification,
            Nodes with the same mesh ID can, communicate with each other.

config MESH_CHANNEL
    int "Mesh network channel"
    range 1 14
    default 13
    help
        Mesh network channel.

config SERVER_IP
    string "Server IP address"
        default "192.168.0.1"
        help
            Server IP address.

config SERVER_PORT
    int "Server port"
        default "8070"
        help
            Server port.

endmenu
```
